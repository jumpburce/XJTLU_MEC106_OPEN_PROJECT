//---------------------------include
#include <Wire.h>
#include <Arduino.h>
#include <U8g2lib.h>
//---------------------------constant define
#define TCAADDR 0x70
#define mpu_addr 0x68

#define bmp1_x 64
#define bmp1_y 64

//--------------------------OLED type define

U8G2_SSD1306_128X64_NONAME_1_HW_I2C u8g2(U8G2_R0,  /* reset=*/ U8X8_PIN_NONE);

//--------------------------TCA module IIC selection

void tcaselect(uint8_t i) {
  if (i > 7) return;
  Wire.begin();
  Wire.beginTransmission(TCAADDR);
  Wire.write(1 << i);
  Wire.endTransmission(); 
}

//--------------------------bmp image
static const unsigned char bmp1[] U8X8_PROGMEM = {
  0x00, 0x00, 0x00, 0x00, 0x00, 0x00, 0x00, 0x00, 0x00, 0x00, 0x00, 0x00, 0x00, 0x00, 0x00, 0x00, 0x00, 0x00, 0x00, 0x00, 0x00, 0x00, 0x00, 0x00, 0x00, 0x00, 0x00, 0x00, 0x00, 0x00, 0x00, 0x00,
  0x00, 0x00, 0x00, 0x00, 0x00, 0x00, 0x00, 0x00, 0x00, 0x00, 0x00, 0x00, 0x00, 0x00, 0x00, 0x00, 0x00, 0x00, 0x00, 0x00, 0x00, 0x00, 0x00, 0x00, 0x00, 0x00, 0x00, 0x00, 0x00, 0x00, 0x00, 0x00,
  0x00, 0x00, 0x00, 0x00, 0x00, 0x00, 0x00, 0x00, 0x00, 0x00, 0x00, 0x00, 0x00, 0x00, 0x00, 0x00, 0x00, 0x20, 0x00, 0x00, 0x00, 0x00, 0x00, 0x00, 0x00, 0xD0, 0x00, 0x00, 0x00, 0x00, 0x0F, 0x00,
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  0x00, 0x00, 0x00, 0x00, 0x00, 0x00, 0x00, 0x00, 0x00, 0x00, 0x00, 0x00, 0x00, 0x00, 0x00, 0x00, 0x00, 0x00, 0x00, 0x00, 0x00, 0x00, 0x00, 0x00, 0x00, 0x00, 0x00, 0x00, 0x00, 0x00, 0x00, 0x00
};

const unsigned char bmpsand[] U8X8_PROGMEM = {
0x00,0x00,0x00,0x80,0x00,0x00,0x00,0x00,0x00,0x00,0x00,0x80,0x01,0x00,0x00,0x00,
0x00,0x00,0x00,0xC0,0x03,0x00,0x00,0x00,0x00,0x00,0x00,0xC0,0x03,0x00,0x00,0x00,
0x00,0x00,0x00,0xE0,0x07,0x00,0x00,0x00,0x00,0x00,0x00,0xE0,0x07,0x00,0x00,0x00,
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0x80,0xFF,0xFF,0xFF,0xFF,0xFF,0xFF,0x01,0xC0,0xFF,0xFF,0xFF,0xFF,0xFF,0xFF,0x00
};

static const unsigned char bmpblank[] U8X8_PROGMEM = {
  0x00, 0x00, 0x00, 0x00, 0x00, 0x00, 0x00, 0x00
};


//---------------------------------MPU6050

void WriteMPUReg(int nReg, unsigned char nVal) {
  Wire.beginTransmission(mpu_addr);
  Wire.write(nReg);
  Wire.write(nVal);
  Wire.endTransmission(true);
}

void config_mpu()
{
  Wire.beginTransmission(mpu_addr); //开启MPU-6050的传输
  Wire.write(0x1C); //加速度倍率寄存器的地址
//  Wire.requestFrom(mpu_addr, 1, true); //先读出原配置
//  unsigned char acc_conf = Wire.read();
  unsigned char acc_conf = (0 << 3);
  Wire.write(acc_conf);
  Wire.endTransmission(true); //结束传输，true表示释放总线
  Wire.beginTransmission(mpu_addr); //开启MPU-6050的传输
  Wire.write(0x1B); //角速度倍率寄存器的地址
  unsigned char gw_conf = Wire.read();
  acc_conf = (0 << 3);
  Wire.write(gw_conf);
  Wire.endTransmission(true); //结束传输，true表示释放总线  
}

unsigned char ReadMPUReg(int nReg) {
  Wire.beginTransmission(mpu_addr);
  Wire.write(nReg);
  Wire.requestFrom(mpu_addr, 1, true);
  Wire.endTransmission(true);
  return Wire.read();
}

float get_az()
{
  int val;
  Wire.beginTransmission(mpu_addr); //开启MPU-6050的传输
  Wire.write(0x3F); //指定寄存器地址
  Wire.requestFrom(mpu_addr, 2, true); //将输据读出到缓存
  val = Wire.read() << 8 | Wire.read(); //两个字节组成一个16位整数
  float az=(float)val/32768.0*2.0*9.8f;
  Serial.print("az:");Serial.println(az);
  Wire.endTransmission(true); //结束传输，true表示释放总线
  return az;  
}

void setup()
{
  Wire.begin();
  Serial.begin(115200);
  //------------------------OLED init
  for(int i=0;i<2;i++){
   tcaselect(i);
    u8g2.begin();
    u8g2.enableUTF8Print();
    u8g2.setFont(u8g2_font_ncenB14_tr);
    u8g2.firstPage();
    do{
      u8g2.drawXBMP(32, 0, bmp1_x, bmp1_y, bmp1);
    }while(u8g2.nextPage());
  }
  //-----------------------MPU init
  tcaselect(2);
  WriteMPUReg(0x6B, 0);
  config_mpu();
  delay(2000);
}

int curs = 0;
int count_scl= 0;
int curs_scl = 0;

int second_count = 0, min_count = 0 , hour_count = 0, each_second = 100;
char second[32] ,min[32] , hour[32];
bool add_flag = false;

void loop(){
  if (count_scl <= 0) count_scl = 0;
  if (count_scl >= 640) count_scl = 640;
  tcaselect(2);
  //-------------------------------up
  if(get_az()>8){
    //sand anime
    if(curs == 0){
      curs = 1;
    }
    else if(curs == 1){
      curs = 2;
    }
    else{
      curs = 0;
    }
    if(count_scl == 640){
      
    }
    else{
    //----------------------------OLED_1
      tcaselect(0);
      u8g2.firstPage();
    do{
      u8g2.setDisplayRotation(U8G2_R0);
       //u8g2.setDisplayRotation(0);
      u8g2.setFont(u8g2_font_ncenB10_tr);
      curs_scl = count_scl/10;
      u8g2.drawXBMP(32,64 - curs_scl,bmp1_x, bmp1_y,bmpsand);
      for(int i = 0;i<64;i=i+10){
      u8g2.drawVLine(64, i+curs*2, 3);
      u8g2.drawVLine(63, i+curs*3, 4);
      u8g2.drawVLine(65, i+curs*2, 3);
      }
    }while(u8g2.nextPage());
    //-----------------------------OLED_0
    tcaselect(1);
    u8g2.firstPage();
    do{
      u8g2.drawXBMP(32,1,bmp1_x, bmp1_y,bmpsand);
      for(int i = 0; i<curs_scl;i++){
      u8g2.drawXBMP(32,64-i,64, 1,bmpblank);
      //u8g2.drawXBMP(32, i, 64, 1, bmpblank);
      }
    }while(u8g2.nextPage());
    count_scl+=10;
    }
    
  }
  //-----------------------------down
  else if (get_az()<-8){
    
    if(curs == 0){
      curs = 1;
    }
    else if(curs == 1){
      curs = 2;
    }
    else{
      curs = 0;
    }
    if(count_scl == 0){
      
    }
    else{
    //----------------------------OLED_1
      tcaselect(0);
      u8g2.firstPage();
    do{
      u8g2.setDisplayRotation(U8G2_R0);
      u8g2.drawXBMP(32,1,bmp1_x, bmp1_y,bmpsand);
      for(int i = 0; i<curs_scl;i++){
      u8g2.drawXBMP(32,64-i,64, 1,bmpblank);
      }
    }while(u8g2.nextPage());

    //-----------------------------OLED_0
    tcaselect(1);
    u8g2.firstPage();
    do{
      u8g2.setFont(u8g2_font_ncenB10_tr);
      curs_scl = count_scl/10;
      u8g2.drawXBMP(32,64 - curs_scl,bmp1_x, bmp1_y,bmpsand);
      for(int i = 0;i<64;i=i+10){
      u8g2.drawVLine(64, i+curs*2, 3);
      u8g2.drawVLine(63, i+curs*3, 4);
      u8g2.drawVLine(65, i+curs*2, 3);
      }
    }while(u8g2.nextPage());
    count_scl-=10;
    }
  }
  //-----------------------------horizontal
  else if (get_az() <=6 || get_az() >= -6){

      each_second--;
       if(!each_second)
       {
           second_count++;
           each_second = 100;
           add_flag = true;
       }
       if (second_count ==60)
       {
           min_count++;
           second_count = 0;
       }
       if(min_count == 60)
       {
           hour_count++;
           min_count = 0;
           if(hour_count == 24)
           {
               second_count =0;
               min_count =0;
               hour_count =0;
           }
       }
       sprintf(hour,"%d ",hour_count);
       sprintf(min,"%d ",min_count);
       sprintf(second,"%d\n",second_count);
       if(add_flag)
       {
          tcaselect(0);
          u8g2.firstPage();
          
          do {
            u8g2.setDisplayRotation(U8G2_MIRROR);
            u8g2.setFont(u8g2_font_ncenB14_tr);
            u8g2.setFontDirection(1);
            u8g2.drawStr(60,15,hour);
            u8g2.drawStr(60,30,min);
            u8g2.drawStr(60,45,second);
          } while ( u8g2.nextPage() );
            tcaselect(1);
          u8g2.firstPage();
          do {
            u8g2.setFont(u8g2_font_ncenB14_tr);
            u8g2.drawStr(68,44,hour);
            u8g2.drawStr(50,44,min);
            u8g2.drawStr(32,44,second);
          } while ( u8g2.nextPage() );
           add_flag = false;
       }
       
  }
  delay(10);
  }
